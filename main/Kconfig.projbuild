## main/Kconfig.projbuild
```kconfig
menu "Clockwise Configuration"

  config HUB75_BLUE_GREEN_SWAP
    bool "Swap blue and green colors"
    help
        Some 64x64 HUB75 displays have the green and blue pins reversed. Enable this option to swap these pins.

  # All clockfaces are compiled in simultaneously.
  # Runtime selection is done via CWDriverRegistry (index 0-5).
  # The individual CONFIG_CLOCKFACE_* guards have been removed from each
  # cw-cf-0xNN CMakeLists.txt — all source files always compile.

endmenu
```

## sdkconfig.defaults
```kconfig
CONFIG_AUTOSTART_ARDUINO=y
CONFIG_FREERTOS_HZ=1000
CONFIG_CLOCKFACE_MARIO=y
CONFIG_PARTITION_TABLE_CUSTOM=y
CONFIG_PARTITION_TABLE_CUSTOM_FILENAME="partitions.csv"
CONFIG_ESPTOOLPY_FLASHSIZE_4MB=y
CONFIG_ESPTOOLPY_FLASHSIZE="4MB"
# OTA rollback: if the app crashes before calling esp_ota_mark_app_valid_cancel_rollback(),
# the bootloader automatically reverts to the previous OTA partition on next boot.
CONFIG_BOOTLOADER_APP_ROLLBACK_ENABLE=y
```
